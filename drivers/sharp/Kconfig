## drivers/sharp/Kconfig
```kconfig
#
# SHARP configuration
#

menu "SHARP Device Drivers"

source "drivers/sharp/shdiag/Kconfig"
source "drivers/sharp/tunerdrv/Kconfig"

source "drivers/sharp/shbatt/Kconfig"

source "drivers/sharp/shkeyled/Kconfig"
source "drivers/sharp/shflip/Kconfig"
source "drivers/sharp/shtrpd/Kconfig"
source "drivers/sharp/shswic/Kconfig"
# CONFIG_SHBOOT_CUST start
source "drivers/sharp/shboot/Kconfig"
# CONFIG_SHBOOT_CUST end
source "drivers/sharp/shterm/Kconfig"
source "drivers/sharp/vold/Kconfig"
source "drivers/sharp/shirda/Kconfig"
source "drivers/sharp/shlog/Kconfig"
source "drivers/sharp/shtimer/Kconfig"
#/* SH_AUDIO_DRIVER -> */ /*17-006*/
source "drivers/sharp/shaudio/Kconfig"
#/* SH_AUDIO_DRIVER <- */ /*17-006*/
source "drivers/sharp/shmds/Kconfig"
source "drivers/sharp/shsensor_hub/ml630q790/Kconfig"

# NFC/FeliCa driver
source "drivers/sharp/nfc/Kconfig"

endmenu
```

## drivers/sharp/shboot/Kconfig
```kconfig
#
# SH Boot Configuration
#

menu "SHBoot driver"

config SHBOOT_CUST
	bool "SHARP BOOT CUSTOMIZE"
	depends on SHSYS_CUST
	default n

config SHSECBOOT_CUST
	bool "SHARP SECBOOT CUSTOMIZE"
	default y

endmenu
```

## drivers/sharp/shkeyled/Kconfig
```kconfig
# drivers/sharp/shkeyled/Kconfig

menu "SHARP KEYLED Device Drivers"

config LEDS_KEY_LED
	bool "SHARP KEYLED Device Drivers"
	default n

endmenu
```

## drivers/sharp/shmds/Kconfig
```kconfig
menuconfig SHMDS
	bool "Motion Sensor Drivers"
	default y

if SHMDS
source "drivers/sharp/shmds/motionsensor/Kconfig"
# SHMDS_ID_0103_01 del S
# source "drivers/sharp/shmds/mpu6515/Kconfig"
# source "drivers/sharp/shmds/mpu6515/inv_test/Kconfig"
# SHMDS_ID_0103_01 del E

endif
```

## drivers/sharp/shswic/Kconfig
```kconfig
# drivers/sharp/shswic/Kconfig

menu "SWIC Device Drivers"

config USB_SWIC
	bool "USB switch IC Driver"

config AC_ADAPTER_SWIC
	bool "AC_ADAPTER switch IC Driver"

config IRREGULAR_CHARGER_SWIC
	bool "IRREGULAR_CHARGER switch IC Driver"

config CRADLE_SWIC
	bool "CRADLE switch IC Driver"

config HOST_SWIC
	bool "HOST switch IC Driver"

config HEADSET_BUTTON_SWIC
	bool "HEADSET BUTTON enable IC Driver"

endmenu
```

## drivers/sharp/shtrpd/Kconfig
```kconfig
# drivers/sharp/shtrpd/Kconfig

menu "SHARP TrackPad Drivers"

config TRACKPAD_SHTRPD
	bool "TrackPad Driver"

endmenu
```
