/* Copyright (c) 2014, The Linux Foundation. All rights reserved.
*
* This program is free software; you can redistribute it and/or modify
* it under the terms of the GNU General Public License version 2 and
* only version 2 as published by the Free Software Foundation.
*
* This program is distributed in the hope that it will be useful,
* but WITHOUT ANY WARRANTY; without even the implied warranty of
* MERCHANTABILITY or FITNESS FOR A PARTICULAR PURPOSE.  See the
* GNU General Public License for more details.
*/

/dts-v1/;

#include "msm8909-mtp.dtsi"
//#include "msm8909-camera-sensor-mtp.dtsi"
#include "msm8909-pm8916.dtsi"
#include "msm8909-pm8916-mtp.dtsi"
#include "sharp-common.dtsi"
#include "sharp-pm8916-common.dtsi"
#include "sharp-pg40.dtsi"
#include "sharp-pg40-camera-sensor-mtp.dtsi"

/ {
	model = "sharp pg40";
	compatible = "qcom,sharp-pg40", "qcom,msm8909", "qcom,mtp";
	qcom,board-id= <8 0x4>;
};

&pm8916_chg {
	status = "ok";
	qcom,use-external-charger;
};

&pm8916_bms {
	status = "ok";
	qcom,disable-bms;
};

