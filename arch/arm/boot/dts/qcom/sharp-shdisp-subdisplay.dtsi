/* Copyright (c) 2014, The Linux Foundation. All rights reserved.
 *
 * This program is free software; you can redistribute it and/or modify
 * it under the terms of the GNU General Public License version 2 and
 * only version 2 as published by the Free Software Foundation.
 *
 * This program is distributed in the hope that it will be useful,
 * but WITHOUT ANY WARRANTY; without even the implied warranty of
 * MERCHANTABILITY or FITNESS FOR A PARTICULAR PURPOSE.  See the
 * GNU General Public License for more details.
 */

&soc {

	/*---------------------*/
	/*     BLSP1 QUP4     */
	/*---------------------*/
	blsp1_spi5: spi@78b9000  {
		sub_spi@0 {
			status = "disable";
			compatible = "sharp,subdisplay_spi";
			reg = <0>;
			spi-max-frequency = <10000000>;
			subdisplay_a0_gpio = <&msm_gpio 51 0>;
		};
	};

	/*---------------------*/
	/* LCD controller      */
	/*---------------------*/
	sharp,shdisp_subdisplay {
		compatible = "sharp,shdisp_subdisplay";
		status = "disable";
		subdisplay_vdd-supply = <&pm8916_l16>;
		subdisplay_vddio-supply = <&pm8916_l5>;
	};
};
