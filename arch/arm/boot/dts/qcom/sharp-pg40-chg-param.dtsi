/* Copyright (c) 2014, The Linux Foundation. All rights reserved.
 *
 * This program is free software; you can redistribute it and/or modify
 * it under the terms of the GNU General Public License version 2 and
 * only version 2 as published by the Free Software Foundation.
 *
 * This program is distributed in the hope that it will be useful,
 * but WITHOUT ANY WARRANTY; without even the implied warranty of
 * MERCHANTABILITY or FITNESS FOR A PARTICULAR PURPOSE.  See the
 * GNU General Public License for more details.
 */


/****************************************/
/*  smb1360_otg_supply: smb1360-chg-fg@14			*/
/****************************************/
&i2c_4 {
	smb1360_otg_supply: smb1360-chg-fg@14 {
		qcom,float-voltage-mv = <4360>;
		qcom,fastchg-current-ma = <1200>;
		qcom,charging-timeout = <768>;
		/delete-property/ qcom,charging-disabled;
		qcom,recharge-thresh-mv = <50>;
		/delete-property/ qcom,recharge-disabled;
		qcom,iterm-ma = <100>;
		/delete-property/ qcom,iterm-disabled;
		qcom,chg-inhibit-disabled;
		/delete-property/ qcom,batt-id-disabled;
		qcom,fg-delta-soc = <1>;
// 		qcom,fg-soc-max;
// 		qcom,fg-soc-min;
		qcom,fg-voltage-min-mv = <3350>;
		qcom,fg-voltage-empty-mv = <3100>;
		/delete-property/ qcom,stat-pulsed-irq;
		qcom,shdn-after-pwroff;
		/delete-property/ qcom,empty-soc-disabled;
		/delete-property/ qcom,awake-min-soc;
		/delete-property/ qcom,batt-profile-select;
// 		qcom,profile-a-rid-kohm;
		qcom,profile-b-rid-kohm;
// 		qcom,batt-id-vref-uv;
		qcom,batt-id-rpullup-kohm;
		qcom,fg-batt-capacity-mah = <1800>;
		qcom,fg-cc-soc-coeff = <0x888D>;
		qcom,fg-cutoff-voltage-mv = <3400>;
		qcom,fg-iterm-ma = <400>;
		qcom,fg-ibatt-standby-ma = <10>;
		qcom,fg-cc-to-cv-mv = <4340>;
		qcom,thermistor-c1-coeff = <0x86DA>;
// 		qcom,otg-batt-curr-limit;
		qcom,fg-auto-recharge-soc = <90>;
		qcom,min-icl-100ma;
		/delete-property/ qcom,config-hard-thresholds;
		qcom,hot-bat-decidegc  = <550>;
		qcom,cold-bat-decidegc = <0>;
		qcom,soft-jeita-supported;
		qcom,warm-bat-decidegc = <450>;
		qcom,cool-bat-decidegc = <100>;
		qcom,warm-bat-mv = <4240>;
		qcom,cool-bat-mv = <4240>;
		qcom,warm-bat-ma = <1200>;
		qcom,cool-bat-ma = <1200>;
		qcom,fg-reset-at-pon;
		qcom,fg-reset-thresold-mv = <0>;
		/delete-property/ qcom,rsense-10mhom;
		/delete-property/ qcom,otg-fet-present;
		/delete-property/ qcom,parallel-charging-enabled;
// 		qcom,max-parallel-current-ma;
		qcom,maintenance-vfloat-delta = <50>;
		qcom,vfloat-min-delta = <10>;
		qcom,maintenance-ibat-ma = <80>;
	};
};
