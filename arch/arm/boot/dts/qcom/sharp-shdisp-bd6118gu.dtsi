/* Copyright (c) 2014, The Linux Foundation. All rights reserved.
 *
 * This program is free software; you can redistribute it and/or modify
 * it under the terms of the GNU General Public License version 2 and
 * only version 2 as published by the Free Software Foundation.
 *
 * This program is distributed in the hope that it will be useful,
 * but WITHOUT ANY WARRANTY; without even the implied warranty of
 * MERCHANTABILITY or FITNESS FOR A PARTICULAR PURPOSE.  See the
 * GNU General Public License for more details.
 */

&soc {
	/*---------------------*/
	/* backlight IC        */
	/*---------------------*/
	sharp,shdisp_bd6118gu {
		compatible = "sharp,shdisp_bdic";
		status = "disable";
		bdic_irq_gpio  = <&msm_gpio 110 0x00>;
		interrupt-parent  = <&msm_gpio>;
		interrupts = <110 0>;
		interrupt-names = "bdic_irq";
		pinctrl-names = "bdic_irq_gpio_active","bdic_irq_gpio_suspend";
		pinctrl-0 = <&bdic_irq_gpio_active>;
		pinctrl-1 = <&bdic_irq_gpio_suspend>;
		bdic_rst_gpio = <&msm_gpio 30 0>;
		vddio-supply = <&pm8916_l5>;
	};

	i2c@78b8000 {
		bdic_i2c@76 {
			compatible = "sharp,bdic_i2c";
			status = "ok";
			reg = <0x76>;
		};
	};

};
